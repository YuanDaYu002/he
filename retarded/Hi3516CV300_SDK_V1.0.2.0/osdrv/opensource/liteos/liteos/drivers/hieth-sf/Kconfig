## retarded/Hi3516CV300_SDK_V1.0.2.0/osdrv/opensource/liteos/liteos/drivers/hieth-sf/Kconfig
```kconfig
config LOSCFG_DRIVERS_HIETH_SF
    bool "Enable hieth-sf"
    depends on LOSCFG_DRIVERS_NETDEV && (LOSCFG_PLATFORM_HI3518EV200 || LOSCFG_PLATFORM_HI3911 || LOSCFG_PLATFORM_HIM5V100 || LOSCFG_PLATFORM_HI3731  || LOSCFG_PLATFORM_HI3516CV300)
```

## retarded/Hi3516CV300_SDK_V1.0.2.0/osdrv/opensource/liteos/liteos/drivers/i2c/Kconfig
```kconfig
config LOSCFG_DRIVERS_I2C
    bool "Enable I2C"
    default y
    depends on LOSCFG_DRIVERS
    help
      Answer Y to enable LiteOS support i2c.
config LOSCFG_I2C_ADAPTER_COUNT
    int "Number of i2c adapter count"
    depends on LOSCFG_DRIVERS_I2C
    range 0 128
    default 4
    help
      I2c adatper count, range from 0 to 128.
config LOSCFG_HOST_TYPE_HIBVT
    bool "i2c host type is hibvt"
    default y
    depends on LOSCFG_DRIVERS && (LOSCFG_PLATFORM_HIFONE || LOSCFG_PLATFORM_HI3516CV300)
    help
      i2c host type is hibvt.
```

## retarded/Hi3516CV300_SDK_V1.0.2.0/osdrv/opensource/liteos/liteos/drivers/pm/Kconfig
```kconfig
config LOSCFG_DRIVERS_PM
    bool "Enable PM"
    default y
    depends on LOSCFG_DRIVERS && (LOSCFG_PLATFORM_HI3559_CORTEX_A17 || LOSCFG_PLATFORM_HI3556_CORTEX_A17)
    help
      Answer Y to enable LiteOS support pm.
```

## retarded/Hi3516CV300_SDK_V1.0.2.0/osdrv/opensource/liteos/liteos/drivers/usb/Kconfig
```kconfig
config LOSCFG_DRIVERS_USB
    bool "Enable USB"
    default y
    depends on LOSCFG_DRIVERS
    help
      Answer Y to enable LiteOS support usb.

config LOSCFG_DRIVERS_USB_HOST_DRIVER
    bool "Enable USB HCD"
    default y
    depends on LOSCFG_DRIVERS_USB && LOSCFG_DRIVERS
    help
      Answer Y to enable LiteOS to support usb host controller driver.

choice
    depends on LOSCFG_DRIVERS_USB_HOST_DRIVER
    prompt "USB HCD"
    default y
    help
      Enable EHCI for USB 2.0.

config LOSCFG_DRIVERS_USB_HOST_EHCI
    bool "Enable EHCI HCD (USB 2.0)"
    depends on LOSCFG_DRIVERS_USB

endchoice

config LOSCFG_DRIVERS_USB_DEVICE_CLASS_DRIVERS
    bool "Enable USB Device Class Drivers"
    default y
    depends on LOSCFG_DRIVERS_USB && LOSCFG_DRIVERS && LOSCFG_DRIVERS_USB_HOST_DRIVER
    help
      Answer Y to enable LiteOS to support usb device class drivers.

menu "USB Device Class Drivers"
    depends on LOSCFG_DRIVERS_USB_DEVICE_CLASS_DRIVERS
config LOSCFG_DRIVERS_USB_MASS_STORAGE
    bool "Enable USB Mass Storage Support"
    default y
    depends on LOSCFG_DRIVERS_USB_DEVICE_CLASS_DRIVERS && LOSCFG_FS_VFS
    help
      Say Y here if you want to connect USB mass storage devices to your system's USB port.

config LOSCFG_DRIVERS_USB_4G_MODEM
    bool "Enable USB 4G Modem Support"
    default y
    depends on LOSCFG_DRIVERS_USB_DEVICE_CLASS_DRIVERS && LOSCFG_NET_LWIP_SACK
    help
      Say Y here if you want to connect USB 4G devices to your system's USB port.

config LOSCFG_DRIVERS_USB_SERIAL
    bool "Enable USB Serial Converter Support"
    default y
    depends on LOSCFG_DRIVERS_USB_DEVICE_CLASS_DRIVERS
    help
      Say Y here if you want to connect USB serial devices to your system's USB port.

config LOSCFG_DRIVERS_USB_ETHERNET
    bool "Enable USB Ethernet Support"
    depends on LOSCFG_NET_LWIP_SACK && LOSCFG_DRIVERS_USB_DEVICE_CLASS_DRIVERS
    help
      Say Y here if you want to connect USB ethernet devices to your system's USB port.

config LOSCFG_DRIVERS_USB_WIRELESS
    bool "Enable USB Wireless Device Support"
    depends on LOSCFG_NET_LWIP_SACK && LOSCFG_DRIVERS_USB_DEVICE_CLASS_DRIVERS
    help
      Say Y here if you want to connect usb-wifi devices to your system's USB port.

endmenu

config LOSCFG_DRIVERS_USB_DWC_DRIVER
    bool "Enable USB DWC Controller"
    default y
    depends on LOSCFG_DRIVERS_USB && LOSCFG_DRIVERS
    help
      Answer Y to enable LiteOS to support device controller driver.

choice
    depends on LOSCFG_DRIVERS_USB_DWC_DRIVER
    prompt "DWC Controller"
    default y
    help
      This selects the usb(ehci/xhci) family usb device.
      Say Y to enable usb2.0 or usb3.0 controller driver.

config LOSCFG_DRIVERS_USB2_DEVICE_CONTROLLER
    bool "Enable USB2.0 Device Controller"

endchoice

config LOSCFG_DRIVERS_USB_GADGET
    bool "Enable USB Gadget Support"
    default y
    depends on LOSCFG_DRIVERS_USB && LOSCFG_DRIVERS && LOSCFG_DRIVERS_USB_DWC_DRIVER
    help
      Answer Y to enable LiteOS to support usb peripheral devices.
      Enable this configuration option if you want to run LiteOS inside a USB peripheral device.

menu "USB Gadget Drivers"
    depends on LOSCFG_DRIVERS_USB_GADGET

config LOSCFG_DRIVERS_USB_MASS_STORAGE_GADGET
    bool "Enable USB Mass Storage Gadget"
    default y
    depends on LOSCFG_FS_VFS

config LOSCFG_DRIVERS_USB_UVC_GADGET
    bool "Enable USB Video Class Gadget"
    depends on LOSCFG_DRIVERS_USB_GADGET

config LOSCFG_DRIVERS_USB_SERIAL_GADGET
    bool "Enable USB Serial Gadget"
    depends on LOSCFG_DRIVERS_UART && LOSCFG_SHELL

config LOSCFG_DRIVERS_USB_ETHERNET_GADGET
    bool "Enable USB Ethernet Gadget"
    depends on LOSCFG_NET_LWIP_SACK

config LOSCFG_DRIVERS_USB_DFU_GADGET
    bool "Enable USB Dfu Gadget"
    depends on LOSCFG_DRIVERS_USB_GADGET
endmenu
```

## retarded/Hi3516CV300_SDK_V1.0.2.0/osdrv/opensource/liteos/liteos/fs/fat/Kconfig
```kconfig
config LOSCFG_FS_FAT
    bool "Enable FAT"
    default y
    depends on LOSCFG_FS_VFS
    help
      Answer Y to enable LiteOS support fat filesystem.

config LOSCFG_FS_FAT_CACHE
    bool "Enable FAT Cache"
    default y
    depends on LOSCFG_FS_FAT
    help
      Answer Y to enable LiteOS fat filesystem support cache.

config LOSCFG_FS_FAT_CHINESE
    bool "Enable Chinese"
    default y
    depends on LOSCFG_FS_FAT
    help
      Answer Y to enable LiteOS fat filesystem support Chinese.
```

## retarded/Hi3516CV300_SDK_V1.0.2.0/osdrv/opensource/liteos/liteos/kernel/Kconfig
```kconfig
menu "Kernel"
config LOSCFG_KERNEL_LITEKERNEL
    bool "Enable Lite Kernel"
    default y
    help
      This option will enable lite kernel of LiteOS. This is a basic feature,
      so you should say Y here.

config LOSCFG_KERNEL_EXTKERNEL
    bool "Enable Extend Kernel"
    default y
    depends on  LOSCFG_KERNEL_LITEKERNEL
    help
      This option will enable extend Kernel of LiteOS.  Extend kernel include
      cppsupport, cpup, dynload, runstop and scatter. You can select one or some
      of them.

config LOSCFG_KERNEL_CPPSUPPORT
    bool "C++ Support"
    default y
    depends on LOSCFG_KERNEL_EXTKERNEL
    help
      If you wish to build LiteOS with support for C++.

config LOSCFG_KERNEL_CPP_EXCEPTIONS_SUPPORT
    bool "C++ Exceptions Support"
    default n
    depends on LOSCFG_KERNEL_CPPSUPPORT
    help
      If you wish to build LiteOS with exceptions support for C++, eg. try...catch().

config LOSCFG_KERNEL_CPUP
    bool "Enable Cpup"
    default y
    depends on LOSCFG_KERNEL_EXTKERNEL
    help
      If you wish to build LiteOS with support for cpup.

config LOSCFG_KERNEL_DYNLOAD
    bool "Enable Dynamic Load Feature"
    default y
    depends on LOSCFG_KERNEL_EXTKERNEL
    help
      If you wish to build LiteOS with support for dynamic load.

config LOSCFG_KERNEL_RUNSTOP
    bool "Enable Run stop Feature"
    default y
    depends on LOSCFG_KERNEL_EXTKERNEL
    help
      If you wish to build LiteOS with support for run-stop.

config LOSCFG_KERNEL_SCATTER
    bool "Enable Scatter Feature"
    default y
    depends on LOSCFG_KERNEL_EXTKERNEL
    help
      If you wish to build LiteOS with support for scatter.
endmenu
```

## retarded/Hi3516CV300_SDK_V1.0.2.0/osdrv/opensource/liteos/liteos/shell/Kconfig
```kconfig
config LOSCFG_SHELL
    bool "Enable Shell"
    default y
    depends on LOSCFG_DEBUG_VERSION
    help
      Answer Y to enable LiteOS support shell cmd.

config LOSCFG_SHELL_EXCINFO
    bool "Enable Shell excInfo"
    default y
    depends on LOSCFG_DEBUG_VERSION && LOSCFG_SHELL
    help
      Answer Y to enable LiteOS support shell excInfo.
```
